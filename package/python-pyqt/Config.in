## package/python-pyqt/Config.in
```kconfig
config BR2_PACKAGE_PYTHON_PYQT
	bool "python-pyqt"
	depends on BR2_PACKAGE_PYTHON
	select BR2_PACKAGE_PYTHON_SIP
	help
	  PyQt4 is a comprehensive set of Python bindings for 
	  Digia’s Qt cross platform GUI toolkit. 
	  PyQt4 supports Python v2 and v3.

	  http://www.riverbankcomputing.com/software/pyqt/
```

## package/python-sip/Config.in
```kconfig
config BR2_PACKAGE_PYTHON_SIP
	bool "python-sip"
	depends on BR2_PACKAGE_PYTHON
	help
	  SIP is a tool for C/C++ libraries binding. It was developed
	  to create PyQt

	  http://www.riverbankcomputing.com/software/sip/intro
```
